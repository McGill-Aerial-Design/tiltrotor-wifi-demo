#include <ESP8266WiFi.h>
#include <DNSServer.h>

WiFiServer server(80);
DNSServer dnsServer;
IPAddress apIP(172, 217, 28, 1);

byte flap = 0;  // 0, 1, 2
int roll = 0;  // -2, -1, 0, 1, 2
int pitch = 0; // -2, -1, 0, 1, 2
int yaw = 0;   // -2, -1, 0, 1, 2
bool horizontalMode = false;

const char* redirectToHome = "<br><p>You will automatically be redirected to the main page in 5 seconds.</p>\n<meta http-equiv = 'refresh' content = '5; url = /' />\n";
const char* niceTryBro = "<h1>Nice Try Bro</h1>\n<p>Did you really think I would let you break stuff by injecting arbitrary values everywhere?</p>\n<p>Needless to say, your request was blocked</p>\n";

const int logo[] PROGMEM = {0x474E5089, 0x0A1A0A0D, 0x0D000000, 0x52444849, 0x90010000, 0xA7000000, 0x00000304, 0x1799CD00, 0x0000005E, 0x544C5030, 0xFFFFFF45, 0xE6FDFDFD, 0x8787E6E6,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 0x6042AE44, 0x00000082};



unsigned long lastTX = 0;

void transmit_state(){
  Serial.print("MAD\n");
  if (horizontalMode) {Serial.print('h');}
  else {Serial.print('v');}
  Serial.write(flap);
  Serial.write(pitch + 2);
  Serial.write(roll + 2);
  Serial.write(yaw + 2);
  lastTX = millis();
}


void setup() {
  Serial.begin(115200);
  WiFi.mode(WIFI_AP);
  WiFi.softAPConfig(apIP, apIP, IPAddress(255, 255, 255, 0));
  WiFi.softAP("MAD tiltrotor demo");
  dnsServer.start(53, "*", apIP);
  server.begin();
}

void loop() {
  dnsServer.processNextRequest();
  WiFiClient client = server.available();

  if (client){
    while (Serial.available()) {Serial.read();}

    unsigned int t = 0;
    while(!client.available()){
      delay(1);
      t += 1;
      if (t >= 3000){
        client.stop();
        t=0;
        return;
      }
    }



    String req = client.readStringUntil('\n');
    req.remove(req.length() - 10);
    


    if (req.startsWith("POST") or req.startsWith("GET /robots.txt") or req.startsWith("GET /boaform/admin") or req.startsWith("GET /sitemap.xml") or req.startsWith("GET /.well-known/security.txt") or req.startsWith("GET /.vscode/sftp.json") or req.startsWith("GET /client/get_targets") or req.startsWith("GET /showLogin.cc") or req.startsWith("GET http://") or req.startsWith("GET /HNAP") or req.startsWith("GET /config/getuser?") or req.startsWith("GET /.git/config") or req.startsWith("GET jira/jira-webapp-dist/pom.properties")) {
      client.print("HTTP/1.1 204 Not Found\n");
      client.print("Connection: close\n\n");
    }

    else if (req.startsWith("GET /favicon.ico")) {
      client.print("HTTP/1.1 200 OK\n");
      client.print("Content-Type: image/png\n");
      client.print("Content-Length:");
      client.print(sizeof(logo));
      client.print("\n");
      client.print("Connection: close\n\n");

      client.write_P((PGM_P)logo, sizeof(logo));
    }

    else { // normal requests

      client.print("HTTP/1.1 200 OK\n");
      client.print("Connection: close\n\n");
      client.print("<!doctype html>\n<html><head><meta charset=\"UTF-8\">\n");
      client.print("<meta name=\"viewport\" content=\"width=device-width,initial-scale=1\">\n");
      client.print("<title>MAD Tilt-Rotor Control</title>\n");
      client.print("<style>body{margin:0;padding:12px 8px;background:#000;color:#fff;font:16px system-ui,Arial,sans-serif;text-align:center}h1{font-size:1.3em;margin:.4em 0}h3{margin:1.3em 0 .3em;color:#e10600;font-size:1em;letter-spacing:.08em}p{margin:.4em}small{opacity:.75}a{color:#e10600}.w{max-width:430px;margin:auto}button{width:44%;margin:4px;padding:14px 6px;font-size:1em;color:#fff;background:#111;border:1px solid #444;border-radius:10px}button:active{background:#e10600;border-color:#e10600;color:#fff}#T{width:96%;margin:12px 0;padding:26px 10px;font-size:1.5em;font-weight:700;color:#fff;background:#e10600;border:0;border-radius:14px}#dz{width:96%;margin:16px 0 2px;color:#e10600;background:#000;border:2px solid #e10600}#s{min-height:1.3em;font-size:.9em;color:#888}footer{display:block;margin-top:2.5em;font-size:.72em;color:#666}</style>\n");
      client.print("</head><body><div class=w>\n");

      if (req.startsWith("GET /transition")){
        client.print("<h1>TRANSITION</h1>\n");
        client.print("<p style='font-size:1.5em;font-weight:700;color:#e10600'>");
        if (horizontalMode) {client.print("FORWARD FLIGHT &rarr; HOVER");}
        else {client.print("HOVER &rarr; FORWARD FLIGHT");}
        client.print("</p>\n");
        client.print(redirectToHome);
        horizontalMode = !horizontalMode;
      }

      else if (req.startsWith("GET /flap")){
        int newVal = req.substring(9).toInt();
        if (newVal >= 0 and newVal <= 2) {
          client.print("<p>Flaps set to " + String(newVal) + "</p>");
          flap = newVal;
        }
        else {client.print(niceTryBro);}
        client.print(redirectToHome);
      }

      else if (req.startsWith("GET /pitch")){
        int newVal = req.substring(10).toInt();
        if (newVal >= -2 and newVal <= 2) {
          client.print("<p>Pitch set to " + String(newVal) + "</p>");
          pitch = newVal;
        }
        else {client.print(niceTryBro);}
        client.print(redirectToHome);
      }

      else if (req.startsWith("GET /roll")){
        int newVal = req.substring(9).toInt();
        if (newVal >= -2 and newVal <= 2) {
          client.print("<p>Roll set to " + String(newVal) + "</p>");
          roll = newVal;
        }
        else {client.print(niceTryBro);}
        client.print(redirectToHome);
      }

      else if (req.startsWith("GET /yaw")){
        int newVal = req.substring(8).toInt();
        if (newVal >= -2 and newVal <= 2) {
          client.print("<p>Yaw set to " + String(newVal) + "</p>");
          yaw = newVal;
        }
        else {client.print(niceTryBro);}
        client.print(redirectToHome);
      }

      else if (req.startsWith("GET /spray")){
        Serial.print("spray\n");
        client.print("<p>Spraying water...</p>");
        client.print(redirectToHome);
      }



      else {
        client.print("<img src=\"favicon.ico\" style=\"width:78vw;max-width:310px;margin:2px 0 6px\">\n");
        client.print("<p>Current mode: <b>");
        client.print(horizontalMode ? "FORWARD FLIGHT" : "HOVER");
        client.print("</b></p>\n");

        client.print("<a href='/transition'><button id=T>TRANSITION<br><small>");
        client.print(horizontalMode ? "forward flight &rarr; hover" : "hover &rarr; forward flight");
        client.print("</small></button></a>\n");

        if (horizontalMode) {
          client.print("<h3>WINGS</h3>\n");
          client.print("<button onclick=\"q('flaps down','/flap2')\">FLAPS DOWN</button>");
          client.print("<button onclick=\"q('flaps up','/flap0')\">FLAPS UP</button>");
          client.print("<button onclick=\"q('roll left','/roll-2')\">ROLL LEFT</button>");
          client.print("<button onclick=\"q('roll right','/roll+2')\">ROLL RIGHT</button>");

          client.print("<h3>TAIL</h3>\n");
          client.print("<button onclick=\"q('elevator down','/pitch-2')\">ELEV DOWN</button>");
          client.print("<button onclick=\"q('elevator up','/pitch+2')\">ELEV UP</button>");
          client.print("<button onclick=\"q('rudder left','/yaw-2')\">RUDDER LEFT</button>");
          client.print("<button onclick=\"q('rudder right','/yaw+2')\">RUDDER RIGHT</button>");
        }

        client.print("<button id=dz onclick=\"D()\">PARTY MODE</button>");
        client.print("<button onclick=\"q('neutral','/flap0','/roll0','/pitch0','/yaw0')\">NEUTRAL</button>\n");

        client.print("<p id=s>&nbsp;</p>\n");
        client.print("<p><small>flap " + String(flap) + " &middot; roll " + String(roll) + " &middot; pitch " + String(pitch) + " &middot; yaw " + String(yaw) + "</small></p>\n");

        client.print("<script>let b=0,S=document.getElementById('s');const w=m=>new Promise(r=>setTimeout(r,m));async function f(a){for(const u of a){try{await fetch(u)}catch(e){}}}async function q(t,...a){if(b)return;b=1;S.textContent=t+'...';await f(a);location.reload()}async function D(){if(b)return;b=1;for(let i=1;i<4;i++){S.textContent='PARTY '+i+'/3';await f(['/flap2','/roll-2','/pitch-2','/yaw-2');await w(650);await f(['/flap0','/roll+2','/pitch+2','/yaw+2']);await w(650)}await f(['/flap0','/roll0','/pitch0','/yaw0', '/spray']);location.reload()}</script>\n");

        client.print("<p><b style='color:#e10600'>Ask us how to apply!</b></p>\n");

        //client.print("<footer>Disclaimer to anyone complaining about how ugly this website looks:<br>This was made by someone in mech eng. I don't give a **** about graphics or UI.<br>Just be happy I know enough C++ to make the motors turn the right way without starting a fire.</footer>\n");
      }

      client.print("</div></body></html>\n");

      transmit_state();

    }
    client.println();
    client.flush();
    client.stop();
  }


  if (millis() - lastTX > 10000) {
    transmit_state();
  }
}
